/* Includes ------------------------------------------------------------------*/
#include  "stm32f10x_conf.h"
#include  "Table.h"


/* Private typedef -----------------------------------------------------------*/
#define   _MinRPM                                   25
#define   _MaxRPM                                   140
#define   _MinGeneratorCurrent                      5
#define   _MaxGeneratorCurrent                      200

//Current(mA) Watts(*10)
const unsigned short EM_CW[24][31] = {  
    //0	    50	100	    150	    200	    250	    300	    350	    400	    450	    500	    550	    600	    650	    700	    750	    800	    850	    900	    950	    1000	1050	1100	1150	1200	1250	1300	1350	1400	1450	1500	
    {0 ,	2 ,	7 , 	17 ,	31 ,	50 ,	71 ,	99 ,	132 ,	169 ,	209 ,	254 ,	303 ,	355 ,	409 ,	461 ,	515 ,	565 ,	615 ,	663 ,	707 ,	748 ,	785 ,	819 ,	849 ,	879 ,	909 ,	935 ,	961 ,	984 ,	1004  },	//25
    {0 ,	3 ,	10 ,	22 ,	40 ,	61 ,	95 ,	130 ,	174 ,	220 ,	274 ,	331 ,	397 ,	462 ,	531 ,	599 ,	666 ,	736 ,	804 ,	866 ,	926 ,	976 ,	1026 ,	1076 ,	1116 ,	1156 ,	1196 ,	1236 ,	1276 ,	1306 ,	1336  },	//30
    {0 ,	3 ,	12 ,	28 ,	50 ,	79 ,	117 ,	161 ,	213 ,	273 ,	337 ,	412 ,	490 ,	568 ,	655 ,	740 ,	829 ,	916 ,	987 ,	1067 ,	1147 ,	1217 ,	1287 ,	1357 ,	1417 ,	1467 ,	1517 ,	1567 ,	1607 ,	1657 ,	1697  },	//35
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    {0 ,	5 ,	62 ,	167 ,	311 ,	485 ,	699 ,	939 ,	1229 ,	1559 ,	1899 ,	2329 ,	2719 ,	3149 ,	3579 ,	4019 ,	4459 ,	4899 ,	5319 ,	5739 ,	6159 ,	6569 ,	6979 ,	7379 ,	7799 ,	8189 ,	8579 ,	8919 ,	9319 ,	9719 ,	10119  }	//140 
} ;  

//Current(mA) Watts(*10)
const unsigned short GE_CW[24][39] = {
    //0	    50	    100	    150	    200	    250	    300	    350	    400	    450	    500	    550	    600	    650	    700	    750	    800	    850	    900	    950	    1000	1050	1100	1150	1200	1250	1300	1350	1400	1450	1500	1550	1600	1650	1700	1750	1800	1850	1900	
    {0 ,	11 ,	22 ,	39 ,	55 ,	71 ,	87 ,	87 ,	87 ,	87 ,	87 ,	87 ,	87 ,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	87 ,	87 },	//25
    {0 ,	12 ,	19 ,	39 ,	58 ,	78 ,	97 ,	117 ,	136 ,	155 ,	174 ,	193 ,	211 ,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	267 ,	267 },	//30
    {0 ,	5 ,	    16 ,	38 ,	59 ,	83 ,	105 ,	128 ,	148 ,	169 ,	191 ,	211 ,	230 ,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	553 ,	553 },	//35
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    {0 ,	18 ,	112 ,	190 ,	271 ,	348 ,	417 ,	498 ,	575 ,	648 ,	723 ,	790 ,	790 ,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	790 ,	790 }	//140
};

/* Private function prototypes -----------------------------------------------*/
/* Private functions ---------------------------------------------------------*/
/*******************************************************************************
* Function Name  : 轉換控制電流(電磁鐵)
* Description    : 
* Input          : 
* Output         : 
* Return         : EM_CW
*******************************************************************************/
unsigned short Table_GetElectromagnetCurrent(unsigned short Watts,unsigned short Rpm)
{
    unsigned short RetValue = 0 ;
    unsigned char x = 0, y = 0, y1 = 0 ;
    unsigned short EMH = 0,EML = 0;
    unsigned char  B = 0 ;
    
    if( Watts != 0 )
    {
        if( Rpm >= 25 )
        {
            if( Rpm > 140 )
                y = (140-25)/5 ;
            else  
            {
                y = (Rpm-25)/5 ;
                if( ((Rpm-25)%5) != 0 )
                {
                    y1 = y+1 ;
                    B = (Rpm-25)%5 ;
                }
            }
        }
        
        for( x = 0 ; x < 31 ; x++ )
        {
            if( EM_CW[y][x] > Watts )
            {
                if( x >= 1 )
                {
                    EML = ((x-1) * 5) + ((Watts-EM_CW[y][(x-1)])/((EM_CW[y][x]-EM_CW[y][(x-1)])/5)) ;
                }
                else
                {
                    EML = 0 ;
                }
                break ; 
            }
            else
            {
                if( EM_CW[y][x] == Watts )
                {
                    EML = x * 5 ;
                    break ; 
                }
                else if(EM_CW[y][30] < Watts)
                {
                    EML = 30 * 5 ;
                    break;
                }
            }              
        }
        RetValue = EML ;
        
        if( B != 0 )
        {
            for( x = 0 ; x < 31 ; x++ )
            {
                if( EM_CW[y1][x] > Watts )
                {
                    if( x >= 1 )
                    {
                        EMH = ((x-1) * 5) + ((Watts-EM_CW[y1][(x-1)])/((EM_CW[y1][x]-EM_CW[y1][(x-1)])/5)) ;
                    }
                    else
                    {
                        EMH = 0 ;
                    }
                    break ; 
                }
                else
                {
                    if( EM_CW[y1][x] == Watts )
                    {
                        EMH = x * 5 ;
                        break ; 
                    }
                    else if( EM_CW[y1][30] < Watts )
                    {
                        EMH = 30 * 5 ;
                        break;
                    }
                }              
            }
            if( EML >= EMH )
                RetValue = EML - (EML-EMH) * (unsigned short)B / 5 ;
        }
    }  
    
    if( RetValue > 150 )
        RetValue = 150 ;
    return RetValue ;
}



/*******************************************************************************
* Function Name  : 
* Description    : 
* Input          : 
* Output         : 
* Return         : GE_CW
*******************************************************************************/
unsigned short Table_GeneratorCurrent2Watts(unsigned short Current,unsigned short Rpm)
{
    
    unsigned short RetValue = 0 ;
    unsigned char x,x1,y,y1;
    unsigned short WattsHihg,WattsLow ;
    unsigned char A,B  ;
    unsigned short vL,vH ;
    unsigned short GE_I ;
    //
    if( Current > 190 )
        GE_I = 190 ;
    else
        GE_I = Current ;
    //20130221
    y = 0 ;
    y1 = 0 ;
    x = 0 ;
    x1 = 0 ;
    vL = 0 ;
    vH = 0 ;
    //
    if( Rpm >= 25 )
    {
        if( Rpm > 140 )
            y = (140-25)/5 ;
        else  
        {
            y = (Rpm-25)/5 ;
            if( ((Rpm-25)%5) != 0 )
            {
                y1 = y+1 ;
                B = (Rpm-25)%5 ;
            }
        }
    }
    //
    x = GE_I / 5 ;
    if( (GE_I%5) != 0 )
    {
        x1 = x + 1 ;
        A = (GE_I%5) ;
    }
    WattsLow = GE_CW[y][x] ;
    WattsHihg = GE_CW[y][x1] ;
    if( x1 !=  0 )
    {
        if( WattsHihg > WattsLow )
        {
            vL = WattsLow + (unsigned short)((float)(WattsHihg-WattsLow)/5*A) ;
        }
        else
            vL = WattsLow ;
    }
    else
        vL = WattsLow ;
    
    if( y1 != 0 )
    {
        WattsLow = GE_CW[y1][x] ;
        WattsHihg = GE_CW[y1][x1] ;
        if( x1 !=  0 )
        {
            if( WattsHihg > WattsLow )
            {
                vH = WattsLow + (unsigned short)((float)(WattsHihg-WattsLow)/5*A) ;
            }
            else
                vH = WattsLow ;
        }
        else
            vH = WattsLow ;
        
        if( vH > vL )
            RetValue = vL + (unsigned short)((float)(vH-vL)/5*B) ;
        else
            RetValue = vL ;
    }
    else
    {
        RetValue = vL ; 
    }
    
    return RetValue ;
}





